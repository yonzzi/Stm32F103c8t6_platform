# file: Timer_basic.ioc
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Mcu.Family=STM32F1
Mcu.Name=STM32F103C(8-B)Tx
Mcu.Package=LQFP48
NVIC.PriorityGroup=NVIC_PRIORITYGROUP_4
PA13.Mode=Serial_Wire
PA13.Signal=SYS_JTMS-SWDIO
PA14.Mode=Serial_Wire
PA14.Signal=SYS_JTCK-SWCLK
ProjectManager.HeapSize=0x200
ProjectManager.StackSize=0x400
ProjectManager.TargetToolchain=STM32CubeIDE
RCC.APB1Freq_Value=8000000
RCC.APB2Freq_Value=8000000
board=custom

// file: Core/Src/main.c
/* USER CODE BEGIN Header */
/**
  ******************************************************************************
  * @file           : main.c
  * @brief          : Main program body
  ******************************************************************************
  * @attention
  *
  * Copyright (c) 2024 STMicroelectronics.
  * All rights reserved.
  *
  * This software is licensed under terms that can be found in the LICENSE file
  * in the root directory of this software component.
  * If no LICENSE file comes with this software, it is provided AS-IS.
  *
  ******************************************************************************
  */
/* USER CODE END Header */
#include "main.h"

void SystemClock_Config(void);
static void MX_GPIO_Init(void);

/* USER CODE BEGIN 0 */

#define GPIOB_BASE_ADD 0x40010C00
void led_init()
{
	//before using any peripheral -> have to give clock for work
	__HAL_RCC_GPIOB_CLK_ENABLE(); //hal : tÃªn hÃ£ng, RCC: bá»™ táº¡o clock
	//initial to set PB2 in output push-pull
	uint32_t* GPIOB_CRH = (uint32_t*)(GPIOB_BASE_ADD + 0x00);// add base + add offset
	*GPIOB_CRH |=(0b01<<8); //set PB2 in output config ( Mode[1,0] >00-> output; =00-> input) // <<22 lÃ  vá»‹ trÃ­ nha, do mÃ¬nh Ä‘á»ƒ cÃ³ 0bxx nÃªn nÃ³ Ä‘ang khÃ´ng lÃ  32 bit, pháº£i dá»‹ch nÃ³ Ä‘á»ƒ Ä‘Ãºng vá»‹ trÃ­
	*GPIOB_CRH &=~(0b11<<10); // set PB2  in push-pull mode (00)

}
void led_control(char led_state)
{
	//set led in PB2 light
	// add of output data register
	uint32_t* GPIOB_ODR = (uint32_t*)(GPIOB_BASE_ADD + 0x0C);
	if( led_state==1)
	*GPIOB_ODR |= 1<<2;
	else
    *GPIOB_ODR &= ~(1<<2);
}
void timer1_init()
{
	// set 1 sec for timer
	// rcc -> 8M hz -> 1 sec --> psc =8000 -> 1000hz
	// ARR = 1000
    __HAL_RCC_TIM1_CLK_ENABLE();
    uint16_t *TIMER1_ARR = (uint16_t*)0x40012c2c;
    uint16_t *TIMER1_PSC = (uint16_t*)0x40012c28;
    uint16_t *TIMER1_CR1 = (uint16_t*)0x40012c00;
    uint16_t *TIMER1_DIER = (uint16_t*)0x40012c0c;

    *TIMER1_ARR = 1000;
    *TIMER1_PSC = 8 - 1;// as first psc value = 1 -> avoid devide 0

    *TIMER1_CR1 |= 1<<0; // enable cnt
    *TIMER1_DIER |=1<<0; // enable update interrupt ( when count 1ms)
    //*TIMER1_CCR1 |= 1<<0; // enable cnt

    uint32_t *NVIC_ISER0 = (uint32_t*)0xe000e100;
    *NVIC_ISER0 |= 1<<25; // enable timer1 update interrupt in NVIC

}

uint32_t timer1_cnt =0;
void TIM1_UP_IRQHandler()
{
	uint16_t *TIMER1_SR = (uint16_t*)0x40012c10;
	*TIMER1_SR &= ~(1<<0); //clear update interrupt flag
	// khi nhảy vào hàm thì cần clear interrupt flag để reset.
	timer1_cnt++;
}
#if 0
void timer1_delay_1s()
{
	uint16_t *TIMER1_SR = (uint16_t*)0x40012c10;
     while(((*TIMER1_SR>>0) & 1) ==0 ); // wait update interrupt flag is set to 1
    *TIMER1_SR &= ~(1<<0); //clear update interrupt flag

}
#else
void timer1_delay(uint32_t msec)
{
    uint32_t current_cnt = timer1_cnt;
    while((uint32_t)(timer1_cnt- current_cnt) < msec);
}
#endif
/* USER CODE END 0 */

int main(void)
{

  /* MCU Configuration--------------------------------------------------------*/

  /* Reset of all peripherals, Initializes the Flash interface and the Systick. */
  HAL_Init();

  /* Configure the system clock */
  SystemClock_Config();

  /* Initialize all configured peripherals */
  MX_GPIO_Init();
  /* USER CODE BEGIN 2 */
  led_init();
  timer1_init();
  /* USER CODE END 2 */

  /* Infinite loop */
  /* USER CODE BEGIN WHILE */
  while (1)
  {
	  led_control(1);
	  timer1_delay(100);
	  //timer1_delay_1s();
	  led_control(0);
	  timer1_delay(100);
	  //timer1_delay_1s();
    /* USER CODE END WHILE */

  }
}

void SystemClock_Config(void)
{
  RCC_OscInitTypeDef RCC_OscInitStruct = {0};
  RCC_ClkInitTypeDef RCC_ClkInitStruct = {0};

  /** Initializes the RCC Oscillators according to the specified parameters
  * in the RCC_OscInitTypeDef structure.
  */
  RCC_OscInitStruct.OscillatorType = RCC_OSCILLATORTYPE_HSI;
  RCC_OscInitStruct.HSIState = RCC_HSI_ON;
  RCC_OscInitStruct.HSICalibrationValue = RCC_HSICALIBRATION_DEFAULT;
  RCC_OscInitStruct.PLL.PLLState = RCC_PLL_NONE;
  if (HAL_RCC_OscConfig(&RCC_OscInitStruct) != HAL_OK)
  {
    Error_Handler();
  }

  /** Initializes the CPU, AHB and APB buses clocks
  */
  RCC_ClkInitStruct.ClockType = RCC_CLOCKTYPE_HCLK|RCC_CLOCKTYPE_SYSCLK
                              |RCC_CLOCKTYPE_PCLK1|RCC_CLOCKTYPE_PCLK2;
  RCC_ClkInitStruct.SYSCLKSource = RCC_SYSCLKSOURCE_HSI;
  RCC_ClkInitStruct.AHBCLKDivider = RCC_SYSCLK_DIV1;
  RCC_ClkInitStruct.APB1CLKDivider = RCC_HCLK_DIV1;
  RCC_ClkInitStruct.APB2CLKDivider = RCC_HCLK_DIV1;

  if (HAL_RCC_ClockConfig(&RCC_ClkInitStruct, FLASH_LATENCY_0) != HAL_OK)
  {
    Error_Handler();
  }
}

static void MX_GPIO_Init(void)
{

  /* GPIO Ports Clock Enable */
  __HAL_RCC_GPIOA_CLK_ENABLE();

}

void Error_Handler(void)
{
  __disable_irq();
  while (1)
  {
  }
}
