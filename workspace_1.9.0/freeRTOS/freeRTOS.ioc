# file: freeRTOS.ioc
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FREERTOS.Mutexes01=log,Dynamic,NULL
FREERTOS.Queues01=temp_queue,16,float,0,Dynamic,NULL,NULL
FREERTOS.Tasks01=Task1,24,128,Func1,Default,NULL,Dynamic,NULL,NULL;Task2,8,128,Func2,Default,NULL,Dynamic,NULL,NULL;Task3,8,200,Func3,Default,NULL,Dynamic,NULL,NULL;Task4,8,128,Func4,Default,NULL,Dynamic,NULL,NULL;Task5,8,150,Func5,Default,NULL,Dynamic,NULL,NULL
Mcu.Family=STM32F1
Mcu.Name=STM32F103C(8-B)Tx
Mcu.Package=LQFP48
NVIC.PriorityGroup=NVIC_PRIORITYGROUP_4
PA13.Mode=Serial_Wire
PA13.Signal=SYS_JTMS-SWDIO
PA14.Mode=Serial_Wire
PA14.Signal=SYS_JTCK-SWCLK
ProjectManager.HeapSize=0x200
ProjectManager.StackSize=0x400
ProjectManager.TargetToolchain=STM32CubeIDE
RCC.APB1Freq_Value=8000000
RCC.APB2Freq_Value=8000000
VP_FREERTOS_VS_CMSIS_V2.Mode=CMSIS_V2
board=custom

// file: Core/Src/main.c
/* USER CODE BEGIN Header */
/**
  ******************************************************************************
  * @file           : main.c
  * @brief          : Main program body
  ******************************************************************************
  * @attention
  *
  * Copyright (c) 2024 STMicroelectronics.
  * All rights reserved.
  *
  * This software is licensed under terms that can be found in the LICENSE file
  * in the root directory of this software component.
  * If no LICENSE file comes with this software, it is provided AS-IS.
  *
  ******************************************************************************
  */
/* USER CODE END Header */
#include "main.h"
#include "cmsis_os.h"

/* USER CODE BEGIN Includes */
#include "led.h"
#include "uart.h"
/* USER CODE END Includes */

 /* Definitions for Task1 */
osThreadId_t Task1Handle;
const osThreadAttr_t Task1_attributes = {
  .name = "Task1",
  .stack_size = 128 * 4,
  .priority = (osPriority_t) osPriorityNormal,
};
/* Definitions for Task2 */
osThreadId_t Task2Handle;
const osThreadAttr_t Task2_attributes = {
  .name = "Task2",
  .stack_size = 128 * 4,
  .priority = (osPriority_t) osPriorityLow,
};
/* Definitions for Task3 */
osThreadId_t Task3Handle;
const osThreadAttr_t Task3_attributes = {
  .name = "Task3",
  .stack_size = 200 * 4,
  .priority = (osPriority_t) osPriorityLow,
};
/* Definitions for Task4 */
osThreadId_t Task4Handle;
const osThreadAttr_t Task4_attributes = {
  .name = "Task4",
  .stack_size = 128 * 4,
  .priority = (osPriority_t) osPriorityLow,
};
/* Definitions for Task5 */
osThreadId_t Task5Handle;
const osThreadAttr_t Task5_attributes = {
  .name = "Task5",
  .stack_size = 150 * 4,
  .priority = (osPriority_t) osPriorityLow,
};
/* Definitions for temp_queue */
osMessageQueueId_t temp_queueHandle;
const osMessageQueueAttr_t temp_queue_attributes = {
  .name = "temp_queue"
};
/* Definitions for log */
osMutexId_t logHandle;
const osMutexAttr_t log_attributes = {
  .name = "log"
};

void SystemClock_Config(void);
static void MX_GPIO_Init(void);
void Func1(void *argument);
void Func2(void *argument);
void Func3(void *argument);
void Func4(void *argument);
void Func5(void *argument);

int main(void)
{

  /* MCU Configuration--------------------------------------------------------*/

  /* Reset of all peripherals, Initializes the Flash interface and the Systick. */
  HAL_Init();

  /* Configure the system clock */
  SystemClock_Config();

  /* Initialize all configured peripherals */
  MX_GPIO_Init();

  /* Init scheduler */
  osKernelInitialize();
  /* Create the mutex(es) */
  /* creation of log */
  logHandle = osMutexNew(&log_attributes);

  /* Create the queue(s) */
  /* creation of temp_queue */
  temp_queueHandle = osMessageQueueNew (16, sizeof(float), &temp_queue_attributes);

  /* Create the thread(s) */
  /* creation of Task1 */
  Task1Handle = osThreadNew(Func1, NULL, &Task1_attributes);

  /* creation of Task2 */
  Task2Handle = osThreadNew(Func2, NULL, &Task2_attributes);

  /* creation of Task3 */
  Task3Handle = osThreadNew(Func3, NULL, &Task3_attributes);

  /* creation of Task4 */
  Task4Handle = osThreadNew(Func4, NULL, &Task4_attributes);

  /* creation of Task5 */
  Task5Handle = osThreadNew(Func5, NULL, &Task5_attributes);

  /* Start scheduler */
  osKernelStart();

  /* We should never get here as control is now taken by the scheduler */
  /* Infinite loop */
  while (1)
  {
print("after scheduler");
  }
}

void SystemClock_Config(void)
{
  RCC_OscInitTypeDef RCC_OscInitStruct = {0};
  RCC_ClkInitTypeDef RCC_ClkInitStruct = {0};

  /** Initializes the RCC Oscillators according to the specified parameters
  * in the RCC_OscInitTypeDef structure.
  */
  RCC_OscInitStruct.OscillatorType = RCC_OSCILLATORTYPE_HSI;
  RCC_OscInitStruct.HSIState = RCC_HSI_ON;
  RCC_OscInitStruct.HSICalibrationValue = RCC_HSICALIBRATION_DEFAULT;
  RCC_OscInitStruct.PLL.PLLState = RCC_PLL_NONE;
  if (HAL_RCC_OscConfig(&RCC_OscInitStruct) != HAL_OK)
  {
    Error_Handler();
  }

  /** Initializes the CPU, AHB and APB buses clocks
  */
  RCC_ClkInitStruct.ClockType = RCC_CLOCKTYPE_HCLK|RCC_CLOCKTYPE_SYSCLK
                              |RCC_CLOCKTYPE_PCLK1|RCC_CLOCKTYPE_PCLK2;
  RCC_ClkInitStruct.SYSCLKSource = RCC_SYSCLKSOURCE_HSI;
  RCC_ClkInitStruct.AHBCLKDivider = RCC_SYSCLK_DIV1;
  RCC_ClkInitStruct.APB1CLKDivider = RCC_HCLK_DIV1;
  RCC_ClkInitStruct.APB2CLKDivider = RCC_HCLK_DIV1;

  if (HAL_RCC_ClockConfig(&RCC_ClkInitStruct, FLASH_LATENCY_0) != HAL_OK)
  {
    Error_Handler();
  }
}

static void MX_GPIO_Init(void)
{

  /* GPIO Ports Clock Enable */
  __HAL_RCC_GPIOA_CLK_ENABLE();

}

void Func1(void *argument)
{
  /* USER CODE BEGIN 5 */
	led_init();
  /* Infinite loop */
  for(;;)
  {
	  led_control(led1, 1);
	  HAL_Delay(1000);
	  led_control(led1, 0);
	  osDelay(1000);
  }
  /* USER CODE END 5 */
}

void Func2(void *argument)
{
  /* USER CODE BEGIN Func2 */
	led_init();
  /* Infinite loop */
  for(;;)
  {
	  led_control(led2, 1);
	  osDelay(100);
	  led_control(led2, 0);
	  osDelay(100);
  }
  /* USER CODE END Func2 */
}

/* USER CODE BEGIN Header_Func3 */
float dev_temp;
/**
* @brief Function implementing the Task3 thread.
* @param argument: Not used
* @retval None
*/
/* USER CODE END Header_Func3 */
void Func3(void *argument)
{
  /* USER CODE BEGIN Func3 */
	uart1_init();
	float temp = 0;
  /* Infinite loop */
  for(;;)
  {
	//printlog("hello world\r\n");
	  uint32_t num_msg= osMessageQueueGetCount(temp_queueHandle);
	  osMutexAcquire(logHandle, HAL_MAX_DELAY); //wait until get key
	  // check number of message in queue ( number of data)
	  printlog("device temp: %d [", num_msg);
	  for (int i =0; i< num_msg;i++)
	  {
		  osMessageQueueGet(temp_queueHandle, &temp, 0, HAL_MAX_DELAY);
		  printlog("%2f, ",temp);
	  }
	  printlog("\b\b]\r\n");
	  osMutexRelease(logHandle);
	  //printlog("temp=%.2f\r\n",temp);
    osDelay(3000);
  }
  /* USER CODE END Func3 */
}

void Func4(void *argument)
{
  /* USER CODE BEGIN Func4 */
  /* Infinite loop */
  float temp=0;
  for(;;)
  {
	  temp++;
	  osMessageQueuePut(temp_queueHandle, &temp, 0, HAL_MAX_DELAY);
	  osDelay(500);
  }
  /* USER CODE END Func4 */
}

void Func5(void *argument)
{
  /* USER CODE BEGIN Func5 */
  /* Infinite loop */
  for(;;)
  {
	  osMutexAcquire(logHandle, HAL_MAX_DELAY);
	printlog("hello world\r\n");
	osMutexRelease(logHandle);
    osDelay(1000);
  }
  /* USER CODE END Func5 */
}

void Error_Handler(void)
{
  __disable_irq();
  while (1)
  {
  }
}
