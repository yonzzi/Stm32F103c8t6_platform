# file: SPI_slave.ioc
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Mcu.Family=STM32F1
Mcu.Name=STM32F103C(8-B)Tx
Mcu.Package=LQFP48
NVIC.PriorityGroup=NVIC_PRIORITYGROUP_4
PA13.Mode=Serial_Wire
PA13.Signal=SYS_JTMS-SWDIO
PA14.Mode=Serial_Wire
PA14.Signal=SYS_JTCK-SWCLK
ProjectManager.HeapSize=0x200
ProjectManager.StackSize=0x400
ProjectManager.TargetToolchain=STM32CubeIDE
RCC.APB1Freq_Value=8000000
RCC.APB2Freq_Value=8000000
board=custom

// file: Core/Src/main.c
/* USER CODE BEGIN Header */
/**
  ******************************************************************************
  * @file           : main.c
  * @brief          : Main program body
  ******************************************************************************
  * @attention
  *
  * Copyright (c) 2024 STMicroelectronics.
  * All rights reserved.
  *
  * This software is licensed under terms that can be found in the LICENSE file
  * in the root directory of this software component.
  * If no LICENSE file comes with this software, it is provided AS-IS.
  *
  ******************************************************************************
  */
/* USER CODE END Header */
#include "main.h"

void SystemClock_Config(void);
static void MX_GPIO_Init(void);

/* USER CODE BEGIN 0 */

void spi_init()
{
	// init for spi master.
	// set PA5( alternate func - SPI1_SCK) , PA6( alternate func - SPI1_MISO), PA7 ( alternate func - SPI1_MOSI)
	 __HAL_RCC_GPIOA_CLK_ENABLE();
	 uint32_t * GPIOA_CRL = (uint32_t *)0x40010800;
	// uint32_t * GPIOA_MAPR = (uint32_t *)0x40010004; // alternate func as SPI1
	 uint32_t *GPIOA_ODR = (uint32_t*)(0x4001080C);

	 *GPIOA_CRL &= ~(0xffff << 16); // clear all offset value
	 *GPIOA_CRL |= 0b0100 << 20; // PA5-SPI1_SCK - input float
	 *GPIOA_CRL |= 0b1001 << 24; // PA6-SPI1_MISO - alter output pushpull
	 *GPIOA_CRL |= 0b0100 << 28; // PA7-SPI1_MOSI - input float

	 //*GPIOA_MAPR |=0;

	 //output data
	 *GPIOA_ODR |= (1<<7) | (1<<4); // pull up ?

	//set PA4 input float mode ( SPI1_NSS )
	 *GPIOA_CRL |= 0b0100 << 16;

	// init spi1 in master
	 __HAL_RCC_SPI1_CLK_ENABLE(); //enable 8MHZ clock for spi

	 uint32_t *SPI1_CR1 = (uint32_t *)0x40013000;
	 *SPI1_CR1 &= ~(1<<2); // select slave mode
	 //*SPI1_CR1 |= 0b011<<3; // set baudrate= fclk/16 = 0.5MHZ= 500khzs
	 *SPI1_CR1 |= (1 << 11); // set 16 bit data frame format
	 //*SPI1_CR1 |= (1<<8) | (1<<9); //The value of this bit ( bit 8) is forced onto the NSS pin and the IO value of the NSS pin is ignored.
	                           // use software to control GPIO pin. not hardware ?
	                           //để báo sd chân ngoại vi khác để ddkien select slave này
	 *SPI1_CR1 |= (0b11 << 0); // CPOL =1, CPAL = 1
	 *SPI1_CR1 |= 1<<6; //enable SPI

}

uint16_t rec_data[4]= {0};
uint16_t rec_data1[4]= {0x1122, 0x3344, 0x5566, 0x7890};
void SPI_recieve(){
	uint16_t *SPI1_SR = (uint16_t* )(0x40013008);
	uint16_t *SPI1_DR = (uint16_t* )(0x4001300c);
	for( int i = 0; i < 4; i ++ )
	    {
		//while(((*SPI_SR >> 7) & 1) == 1 );   //  wait not busy
		while(((*SPI1_SR >> 0) & 1) == 0 );  //  wait data be recieve RX buff
		//while(((*SPI_SR >> 6) & 1) == 0 ); // wait not overrun
		rec_data[i] = *SPI1_DR;
		*SPI1_DR = rec_data1[i];
	    }

}

/* USER CODE END 0 */

int main(void)
{

  /* MCU Configuration--------------------------------------------------------*/

  /* Reset of all peripherals, Initializes the Flash interface and the Systick. */
  HAL_Init();

  /* Configure the system clock */
  SystemClock_Config();

  /* Initialize all configured peripherals */
  MX_GPIO_Init();
  /* USER CODE BEGIN 2 */
  spi_init();
  SPI_recieve();
  /* USER CODE END 2 */

  /* Infinite loop */
  while (1)
  {

  }
}

void SystemClock_Config(void)
{
  RCC_OscInitTypeDef RCC_OscInitStruct = {0};
  RCC_ClkInitTypeDef RCC_ClkInitStruct = {0};

  /** Initializes the RCC Oscillators according to the specified parameters
  * in the RCC_OscInitTypeDef structure.
  */
  RCC_OscInitStruct.OscillatorType = RCC_OSCILLATORTYPE_HSI;
  RCC_OscInitStruct.HSIState = RCC_HSI_ON;
  RCC_OscInitStruct.HSICalibrationValue = RCC_HSICALIBRATION_DEFAULT;
  RCC_OscInitStruct.PLL.PLLState = RCC_PLL_NONE;
  if (HAL_RCC_OscConfig(&RCC_OscInitStruct) != HAL_OK)
  {
    Error_Handler();
  }

  /** Initializes the CPU, AHB and APB buses clocks
  */
  RCC_ClkInitStruct.ClockType = RCC_CLOCKTYPE_HCLK|RCC_CLOCKTYPE_SYSCLK
                              |RCC_CLOCKTYPE_PCLK1|RCC_CLOCKTYPE_PCLK2;
  RCC_ClkInitStruct.SYSCLKSource = RCC_SYSCLKSOURCE_HSI;
  RCC_ClkInitStruct.AHBCLKDivider = RCC_SYSCLK_DIV1;
  RCC_ClkInitStruct.APB1CLKDivider = RCC_HCLK_DIV1;
  RCC_ClkInitStruct.APB2CLKDivider = RCC_HCLK_DIV1;

  if (HAL_RCC_ClockConfig(&RCC_ClkInitStruct, FLASH_LATENCY_0) != HAL_OK)
  {
    Error_Handler();
  }
}

static void MX_GPIO_Init(void)
{

  /* GPIO Ports Clock Enable */
  __HAL_RCC_GPIOA_CLK_ENABLE();

}

void Error_Handler(void)
{
  __disable_irq();
  while (1)
  {
  }
}
