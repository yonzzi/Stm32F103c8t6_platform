# file: SPI.ioc
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Mcu.Family=STM32F1
Mcu.Name=STM32F103C(8-B)Tx
Mcu.Package=LQFP48
NVIC.PriorityGroup=NVIC_PRIORITYGROUP_4
PA13.Mode=Serial_Wire
PA13.Signal=SYS_JTMS-SWDIO
PA14.Mode=Serial_Wire
PA14.Signal=SYS_JTCK-SWCLK
ProjectManager.HeapSize=0x200
ProjectManager.StackSize=0x400
ProjectManager.TargetToolchain=STM32CubeIDE
RCC.APB1Freq_Value=8000000
RCC.APB2Freq_Value=8000000
board=custom

// file: Core/Src/main.c
/* USER CODE BEGIN Header */
/**
  ******************************************************************************
  * @file           : main.c
  * @brief          : Main program body
  ******************************************************************************
  * @attention
  *
  * Copyright (c) 2024 STMicroelectronics.
  * All rights reserved.
  *
  * This software is licensed under terms that can be found in the LICENSE file
  * in the root directory of this software component.
  * If no LICENSE file comes with this software, it is provided AS-IS.
  *
  ******************************************************************************
  */
/* USER CODE END Header */
#include "main.h"

/* USER CODE BEGIN PV */
void spi_active_slave()
{
	 uint32_t *GPIOA_ODR = (uint32_t*)(0x4001080C);
	 // Set LOW for PA4
	 *GPIOA_ODR &= ~(1<<4);

}

void spi_inactive_slave()
{
	 uint32_t *GPIOA_ODR = (uint32_t*)(0x4001080C);
	 //set HIGH for PA4
	 *GPIOA_ODR |= (1<<4); // it will inactive when set to high

}
void spi_init()
{
	// init for spi master.
	// set PA5( alternate func - SPI1_SCK) , PA6( alternate func - SPI1_MISO), PA7 ( alternate func - SPI1_MOSI)
	 __HAL_RCC_GPIOA_CLK_ENABLE();
	 uint32_t * GPIOA_CRL = (uint32_t *)0x40010800;
	// uint32_t * GPIOA_MAPR = (uint32_t *)0x40010004; // alternate func as SPI1
	 uint32_t *GPIOA_ODR = (uint32_t*)(0x4001080C);

	 *GPIOA_CRL &= ~(0xffff << 16); // clear all offset value
	 *GPIOA_CRL |= 0b1001 << 20; // PA5-SPI1_SCK - alternate func output push pull
	 *GPIOA_CRL |= 0b0100 << 24; // PA6-SPI1_MISO - input floating
	 *GPIOA_CRL |= 0b1001 << 28; // PA7-SPI1_MOSI - alternate func output push pull

	 //*GPIOA_MAPR |=0;

	 //output data for PA6
	 *GPIOA_ODR |=1<<6;

	//set PA4 output mode ( SPI1_NSS )
	 *GPIOA_CRL |= 0b0001 << 16;

	// init spi1 in master
	 __HAL_RCC_SPI1_CLK_ENABLE(); //enable 8MHZ clock for spi

	 uint32_t *SPI_CR1 = (uint32_t *)0x40013000;
	 *SPI_CR1 |= 1<<2; // select master mode
	 *SPI_CR1 |= 0b011<<3; // set baudrate= fclk/16 = 0.5MHZ= 500khzs

	 *SPI_CR1 |= (1<<8) | (1<<9); //The value of this bit ( bit 8) is forced onto the NSS pin and the IO value of the NSS pin is ignored.
	                           // use software to control GPIO pin. not hardware ?
	                           //để báo sd chân ngoại vi khác để ddkien select slave này
	 *SPI_CR1 |= (1<< 11);			// 16 bit or 8bit
	 *SPI_CR1 |= 0b11<< 0;    // cpol= cpha =1

	 *SPI_CR1 |= 1<<6; //enable SPI

	 spi_inactive_slave();

}

char spi_read_data(char reg)
{
	uint32_t *SPI1_DR = (uint32_t *)0x4001300c;
	uint32_t *SPI1_SR = (uint32_t *)0x40013008;

	// active slave - set PA4 to low

	spi_active_slave();

	// send reg to slave - write reg value to DR of SPI1 ( write 0x8F xuống để báo tôi muốn đọc ip data )

	while(((*SPI1_SR >> 1) & 1) ==0);  //wait tx empty to write data to DR
	*SPI1_DR = reg;
	while(((*SPI1_SR >> 1) & 1) ==1); //wait data can be transferred to TX buffer

	while(((*SPI1_SR >> 0) & 1) ==0); //wait RXNE not empty  (tức là có data về RX) to read data
	while(((*SPI1_SR >> 7) & 1) ==1); // wait not busy

	//clear spam data - read data from DR

	uint8_t temp =*SPI1_DR;

	//send clock for slave to slave send data to master. Write dummy data ( 0x00 or 0xff) to DR
    //just need for cyro sensor or spi mode for stm32f104??
/*	while(((*SPI1_SR >> 1) & 1) ==0);  //wait tx empty to write data to DR
	* SPI1_DR = 0xff;
	while(((*SPI1_SR >> 1) & 1) ==1); //wait data can be transferred to TX buffer

	while(((*SPI1_SR >> 0) & 1) ==0); //wait RXNE not empty  (tức là có data về RX) to read data
	while(((*SPI1_SR >> 7) & 1) ==1); // wait not busy

*/

	//read data from DR

    temp=*SPI1_DR;

	// inactive slave - set PA4 to high
	spi_inactive_slave();
	return temp;
}
volatile uint16_t temp[4];
volatile uint16_t spam;
//void spi_write_data(char *reg, char data)
void spi_write_data(uint16_t *reg)
{
	uint32_t *SPI1_DR = (uint32_t *)0x4001300c;
	uint32_t *SPI1_SR = (uint32_t *)0x40013008;

	// active slave - set PA4 to low

	spi_active_slave();

	*SPI1_SR &=~0x83;// clear reg
	// send reg to slave - write reg value to DR of SPI1 ( write 0x8F xuống để báo tôi muốn đọc ip data )
   for(int i=0; i<=4; i++)
   {
		while(((*SPI1_SR >> 1) & 1) ==0);  //wait tx empty to write data to DR
		*SPI1_DR = *(reg+1);
		while(((*SPI1_SR >> 1) & 1) ==1); //wait data can be transferred to TX buffer

		while(((*SPI1_SR >> 0) & 1) ==0); //wait RXNE not empty  (tức là có data về RX) to read data
		while(((*SPI1_SR >> 7) & 1) ==1); // wait not busy

	//clear spam data - read data from DR

	 temp[i] =*SPI1_DR;
   }
//
//	while(((*SPI1_SR >> 1) & 1) ==0);  //wait tx empty to write data to DR
//	* SPI1_DR = data;
//	while(((*SPI1_SR >> 1) & 1) ==1); //wait data can be transferred to TX buffer
//
//	while(((*SPI1_SR >> 0) & 1) ==0); //wait RXNE not empty  (tức là có data về RX) to read data
//	while(((*SPI1_SR >> 7) & 1) ==1); // wait not busy

	//read data from DR

	spam=*SPI1_DR;

	// inactive slave - set PA4 to high
	spi_inactive_slave();

}

/* USER CODE END PV */

void SystemClock_Config(void);
static void MX_GPIO_Init(void);

int main(void)
{

  /* MCU Configuration--------------------------------------------------------*/

  /* Reset of all peripherals, Initializes the Flash interface and the Systick. */
  HAL_Init();

  /* Configure the system clock */
  SystemClock_Config();

  /* Initialize all configured peripherals */
  MX_GPIO_Init();
  spi_init();
  HAL_Delay(3000);
  uint16_t data_write[4] = {0x1234, 0x5678, 0x9099, 0x5555};
  spi_write_data(data_write);

  //code for stm32f4 read from cyro sensor
  /*
  uint8_t gyro_id =spi_read_data(0x8f); // for cyro sensor
  gyro_id =spi_read_data(0x20); //giá trị của sensor trả về
  spi_write_data(0x20, 0b00001111);
  cyro_id = spi_read_data(0x20);
  */
  /* Infinite loop */
  while (1)
  {

  }
}

void SystemClock_Config(void)
{
  RCC_OscInitTypeDef RCC_OscInitStruct = {0};
  RCC_ClkInitTypeDef RCC_ClkInitStruct = {0};

  /** Initializes the RCC Oscillators according to the specified parameters
  * in the RCC_OscInitTypeDef structure.
  */
  RCC_OscInitStruct.OscillatorType = RCC_OSCILLATORTYPE_HSI;
  RCC_OscInitStruct.HSIState = RCC_HSI_ON;
  RCC_OscInitStruct.HSICalibrationValue = RCC_HSICALIBRATION_DEFAULT;
  RCC_OscInitStruct.PLL.PLLState = RCC_PLL_NONE;
  if (HAL_RCC_OscConfig(&RCC_OscInitStruct) != HAL_OK)
  {
    Error_Handler();
  }

  /** Initializes the CPU, AHB and APB buses clocks
  */
  RCC_ClkInitStruct.ClockType = RCC_CLOCKTYPE_HCLK|RCC_CLOCKTYPE_SYSCLK
                              |RCC_CLOCKTYPE_PCLK1|RCC_CLOCKTYPE_PCLK2;
  RCC_ClkInitStruct.SYSCLKSource = RCC_SYSCLKSOURCE_HSI;
  RCC_ClkInitStruct.AHBCLKDivider = RCC_SYSCLK_DIV1;
  RCC_ClkInitStruct.APB1CLKDivider = RCC_HCLK_DIV1;
  RCC_ClkInitStruct.APB2CLKDivider = RCC_HCLK_DIV1;

  if (HAL_RCC_ClockConfig(&RCC_ClkInitStruct, FLASH_LATENCY_0) != HAL_OK)
  {
    Error_Handler();
  }
}

static void MX_GPIO_Init(void)
{

  /* GPIO Ports Clock Enable */
  __HAL_RCC_GPIOA_CLK_ENABLE();

}

void Error_Handler(void)
{
  __disable_irq();
  while (1)
  {
  }
}
