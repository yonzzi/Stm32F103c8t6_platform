# file: FW2_app1_receive_fr_PC.ioc
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Mcu.Family=STM32F1
Mcu.Name=STM32F103C(8-B)Tx
Mcu.Package=LQFP48
NVIC.PriorityGroup=NVIC_PRIORITYGROUP_4
PA13.Mode=Serial_Wire
PA13.Signal=SYS_JTMS-SWDIO
PA14.Mode=Serial_Wire
PA14.Signal=SYS_JTCK-SWCLK
PB14.Signal=GPIO_Output
ProjectManager.HeapSize=0x200
ProjectManager.StackSize=0x400
ProjectManager.TargetToolchain=STM32CubeIDE
RCC.APB1Freq_Value=8000000
RCC.APB2Freq_Value=8000000
board=custom

// file: Core/Src/main.c
/* USER CODE BEGIN Header */
/**
  ******************************************************************************
  * @file           : main.c
  * @brief          : Main program body
  ******************************************************************************
  * @attention
  *
  * Copyright (c) 2024 STMicroelectronics.
  * All rights reserved.
  *
  * This software is licensed under terms that can be found in the LICENSE file
  * in the root directory of this software component.
  * If no LICENSE file comes with this software, it is provided AS-IS.
  *
  ******************************************************************************
  */
/* USER CODE END Header */
#include "main.h"

void SystemClock_Config(void);
static void MX_GPIO_Init(void);

/* USER CODE BEGIN 0 */
#include "string.h"
#define GPIOA_BASE_ADD 0x40010800
#define GPIOB_BASE_ADD 0x40010C00

char recv_data[10240];//10kb
char rev_fw_done_flag=0;
void uart1_init()
{
   __HAL_RCC_GPIOA_CLK_ENABLE();
   //set PA9 as UART1_Tx, PA10 as UART2_Rx
   uint32_t* GPIOA_CRH = (uint32_t*)(0x40010804);// add base + add offset
    //clear reg using
   *GPIOA_CRH &=~(0xff<<4);
   *GPIOA_CRH |= (0b1001 <<4);  //  output TX PA9  Alternate function push-pull.
   *GPIOA_CRH |= (0b0100 <<8);  // input floating RX PA10.

    //set PA9,10 as choose pin
    uint32_t* AFIO_MAPR = (uint32_t*)(0x40010004);
    *AFIO_MAPR &=~(1<<2);//set map for using PA9,10
    //*AFIO_MAPR =(0<<2);      //set map for using PA9,10

//    UART :
//   + baudrate:9600
//   +frame:
//       + data len : 8 bit
//      +parity : none
   __HAL_RCC_USART1_CLK_ENABLE(); // RCC cấp clock cho uart : 16Mhz

   uint32_t* USART1_BRR = (uint32_t*)(0x40013808);
   uint32_t* USART1_CR1 = (uint32_t*)(0x4001380c);

   //*USART1_BRR =(104<<4)|(3<<0); //define div 104.1667
   *USART1_BRR =(52<<4)|(1<<0); //baud 9600 //fck=8M.
   *USART1_CR1 &=~(1<<10) ;//disable parity. if enable -> continue set even or odd in PS position in USART1_CR1 reg
   *USART1_CR1 &=~(1<<12) ; //use 8 bit data

   *USART1_CR1 |=(1<<13)|(1<<2)|(1<<3); //enable tx,rx và uart tổng

#if 0
   //enable RXNE interr -> when RXNE is set , UART1 generate interr event send to NVIC
   *USART1_CR1 |=(1<<5);

   //NVIC accept interrupt event , Which is send from uart
   uint32_t* NVIC_ISER1 = (uint32_t*)(0xE000E100 + 0x04);
   *NVIC_ISER1 |=(1<<(37-32)); //enable interrupt for event in position 37 in vector table( UART1)
#else
//   //when RXNE is set, send signal to DMA1, DMA1 move data to RAM
//   uint32_t* USART1_CR3 = (uint32_t*)(0x40013814);
//   *USART1_CR3 |= (1<<6);

#endif

}
#define DMA1_BASE_ADD 0x40020000

void dma1_uart1_rx_init(int len)
{
	__HAL_RCC_DMA1_CLK_ENABLE();
	//using DMA1 channel 5 for uart1rx
	//uint32_t* DMA1_CCR5 = (uint32_t*)(DMA1_BASE_ADD + 0x08 + 0x0d20 * 4); //( offset: 0x08 + 0d20 × (channel number – 1))
	uint32_t* DMA1_CCR5 = (uint32_t*)(0x40020058); //addr in app
	uint32_t* DMA1_CNDTR5 = (uint32_t*)(0x4002005c); //DMA channel x number of data register
	uint32_t* DMA1_CPAR5 = (uint32_t*)(0x40020060); // DMA channel x peripheral address register
	uint32_t* DMA1_CMAR5 = (uint32_t*)(0x40020064); // DMA channel x memory address register

	//when RXNE is set, send signal to DMA1, DMA1 move data to RAM
	   uint32_t* USART1_CR3 = (uint32_t*)(0x40013814);
	   *USART1_CR3 |= (1<<6);
	/*
	 * size : 7 bytes
	 * from peripheral addr: uart1_dr  0x40013804
	 * mem addr: rx_buffer ( recv_data) 0x2000042c - search addr in .map file in debug folder.
	 */
	*DMA1_CNDTR5 = len;
	*DMA1_CPAR5 = 0x40013804;
	*DMA1_CMAR5 = recv_data;

	*DMA1_CCR5 |= 1<<7 ; // set memory increment mode -- if do not set this buffer will be override data
	//*DMA1_CCR5 |= 1<<5 ; // enable circular mode
	//*DMA1_CCR5 |= 1<<1 ; // Transfer complete interrupt enable
	 //enable dma after ( read reg(DMA1_CPAR5,DMA1_CMAR5,DMA1_CNDTR5,...) to detail about it)
	*DMA1_CCR5 |= 1<<0 ; //enable channel

	//NVIC accept interrupt event , Which is send from dma1 channel 5
	 //uint32_t* NVIC_ISER0 = (uint32_t*)(0xE000E100 + 0x00);
	 //*NVIC_ISER0 |=(1<<15); //enable interrupt for event in position 15 in vector table(dma1_channel 5)

}

void UART1_send_1byte(char data)
{
   uint32_t* USART1_SR = (uint32_t*)(0x40013800);
   uint32_t* USART1_DR = (uint32_t*)(0x40013804);
   while ( ((*USART1_SR>>7) & 1) == 0 ); // waiting DR empty
   *USART1_DR=data;
   while ( ((*USART1_SR>>6) & 1) == 0 ); //waiting transmit completion
   *USART1_SR &=~(1<<6); //clear bit TC when transmit done.
}
void UART1_send_string(char *msg)
{
   int msg_lenth =strlen(msg);
   for (int i=0;i < msg_lenth;i++)
   {
      UART1_send_1byte(msg[i]);
      //HAL_Delay(1);
   }
}
char UART1_receive_1byte()
{
   uint32_t* USART1_SR = (uint32_t*)(0x40013800);
   uint32_t* USART1_DR = (uint32_t*)(0x40013804);
   while ( ((*USART1_SR>>5) & 1) == 0 ); // waiting RXNE flag to DR have data
   char recv_data= *USART1_DR; //read data
   return recv_data;

}
int rx_index=0;

void DMA1_Channel5_IRQHandler()
{
	__asm("nop");
	//clear flag interrupt (when transfer interrupt complete);
	uint32_t* DMA1_IFCR = (uint32_t*)(0x40020004);
	*DMA1_IFCR |= 1<<17;
	rev_fw_done_flag=1;//when data sufficient set flag =1

}
#define FLASH_BASE_ADDR 0x40022000

#define FLASH_BASE_ADD 0x40022000
uint32_t *FLASH_SR = (uint32_t *) (FLASH_BASE_ADD + 0x0C);  //Flash status register
uint32_t *FLASH_CR = (uint32_t *) (FLASH_BASE_ADD + 0x10);  //Flash status register
uint32_t *FLASH_AR = (uint32_t *) (FLASH_BASE_ADD + 0x14);  //Flash address register
uint32_t *FLASH_KEYR = (uint32_t *) (FLASH_BASE_ADD + 0x04);  //Flash address register

void Flash_erase_page(uint32_t start_add){

	if(((*FLASH_CR >> 7) & 1) == 1){
		// unlocking sequence should be written to the FLASH_KEYR
		*FLASH_KEYR = 0x45670123;
		*FLASH_KEYR = 0xCDEF89AB;
	}

	// Check that no Flash memory operation is ongoing by checking the BSY bit in the FLASH_SR register
	while( ((*FLASH_SR >> 0) & 1) == 1  );

	//Set the PER bit in the FLASH_CR register: Page Erase chosen
	*FLASH_CR |= 1<<1;

	//Program the FLASH_AR register to select a page to erase
	*FLASH_AR = (uint32_t *)(start_add);

	//Set the STRT bit in the FLASH_CR register
	*FLASH_CR |=(1<<6);

	//Wait for the BSY bit to be reset
	while( ((*FLASH_SR >> 0) & 1) == 1 );

	//clear the PER bit in the FLASH_CR register: Page Erase chosen
	*FLASH_CR &= ~(1<<1);
}

//link reference : https://community.st.com/t5/stm32-mcus-products/how-many-times-write-flash-memory-with-stm32f103c8/td-p/209546
// define data as a pointer because it is array with
void Flash_programing(uint32_t address, uint8_t *data, uint32_t num_byte_data){

	//find number page need to delete
	int x = num_byte_data/1024 + 1;// num page + phân dư
	uint32_t add_erase;
	for(int i=0; i< x; i++){
		add_erase = (address + i*1024);
		Flash_erase_page(add_erase);
	}

	if(((*FLASH_CR >> 7) & 1) == 1){
		// unlocking sequence should be written to the FLASH_KEYR
		*FLASH_KEYR = 0x45670123;
		*FLASH_KEYR = 0xCDEF89AB;
	}

	// Check that no Flash memory operation is ongoing by checking the BSY bit in the FLASH_SR register
	while( ((*FLASH_SR >> 0) & 1) == 1  );

	//Set the PG bit in the FLASH_CR register: Flash programming chosen.
	*FLASH_CR |= 1<<0;

	//Perform the data write (half-word = 16 bit) at the desired address.
	for(int i =0; i< num_byte_data; i+=2){
		*(uint16_t*)(address) = (uint16_t)(data[i] + (data[i+1] << 8));
		address += 2; // 16bits = 2 byte. dia chi tang dan 2byte
	}

	//Wait for the BSY bit to be reset
	while( ((*FLASH_SR >> 0) & 1) == 1 );

	//clear the PG bit in the FLASH_CR register
	*FLASH_CR &= ~(1<<0);

}

/* USER CODE END 0 */

int main(void)
{

  /* MCU Configuration--------------------------------------------------------*/

  /* Reset of all peripherals, Initializes the Flash interface and the Systick. */
  HAL_Init();

  /* USER CODE BEGIN Init */
  uart1_init();
  UART1_send_string("update firmware mode\r\n");
  UART1_send_string("pls enter FW size:\r\n");
  int i=0;
  while(strstr(recv_data,"\r\n")== NULL)
  {
	  recv_data[i++]= UART1_receive_1byte();
  }
  uint16_t fw_size =0;
  sscanf(recv_data,"size = %d",&fw_size);
  UART1_send_string("pls send FW data :\r\n");

  dma1_uart1_rx_init(fw_size);
  uint32_t *DMA_CNDTR5 = (uint32_t*)(0x4002005c);
  while(*DMA_CNDTR5 > 0); // wait uart receive all byte data
  UART1_send_string("_Complete receive data_ \r\n");

  //find number page need to delete
//  int x=fw_size/1024 +1; // num page + phân dư
//  for(int i=10;i<(x+10);i++) //need to delete 10th up
//  {
//	  flash_erase_page(i);
//  }
  UART1_send_string("_Complete erase flash \r\n");

  Flash_programing(0x8002800, recv_data, fw_size );//code tuan
//  for ( int i=0;i<fw_size;i+2)
//  {   // it write 16bit=2 byte once.
//	  flash_program((uint16_t*)(0x08002800 +i), recv_data[i]  +(recv_data[i+1]<<8)); // low-byte + high byte.
//  }
  UART1_send_string("complete update, reset chip\r\n");

  // auto reset chip
 uint32_t *AIRCR = (uint32_t*)(0xE000ED0C); //this reg in core arm m3 ( but not detail - see core m4 for detail)
 *AIRCR = (0x05fa << 16) | (1<<2); //set VECTKEYSTAT and SYSRESETREQ

  /* USER CODE END Init */

  /* Configure the system clock */
  SystemClock_Config();

  /* Initialize all configured peripherals */
  MX_GPIO_Init();

  /* Infinite loop */
  /* USER CODE BEGIN WHILE */
  while (1)
  {
//	  HAL_GPIO_WritePin(GPIOB,GPIO_PIN_14, GPIO_PIN_SET );
//	  HAL_Delay(500);
//	  HAL_GPIO_WritePin(GPIOB,GPIO_PIN_14, GPIO_PIN_RESET );
//	  HAL_Delay(500);
    /* USER CODE END WHILE */

  }
}

void SystemClock_Config(void)
{
  RCC_OscInitTypeDef RCC_OscInitStruct = {0};
  RCC_ClkInitTypeDef RCC_ClkInitStruct = {0};

  /** Initializes the RCC Oscillators according to the specified parameters
  * in the RCC_OscInitTypeDef structure.
  */
  RCC_OscInitStruct.OscillatorType = RCC_OSCILLATORTYPE_HSI;
  RCC_OscInitStruct.HSIState = RCC_HSI_ON;
  RCC_OscInitStruct.HSICalibrationValue = RCC_HSICALIBRATION_DEFAULT;
  RCC_OscInitStruct.PLL.PLLState = RCC_PLL_NONE;
  if (HAL_RCC_OscConfig(&RCC_OscInitStruct) != HAL_OK)
  {
    Error_Handler();
  }

  /** Initializes the CPU, AHB and APB buses clocks
  */
  RCC_ClkInitStruct.ClockType = RCC_CLOCKTYPE_HCLK|RCC_CLOCKTYPE_SYSCLK
                              |RCC_CLOCKTYPE_PCLK1|RCC_CLOCKTYPE_PCLK2;
  RCC_ClkInitStruct.SYSCLKSource = RCC_SYSCLKSOURCE_HSI;
  RCC_ClkInitStruct.AHBCLKDivider = RCC_SYSCLK_DIV1;
  RCC_ClkInitStruct.APB1CLKDivider = RCC_HCLK_DIV1;
  RCC_ClkInitStruct.APB2CLKDivider = RCC_HCLK_DIV1;

  if (HAL_RCC_ClockConfig(&RCC_ClkInitStruct, FLASH_LATENCY_0) != HAL_OK)
  {
    Error_Handler();
  }
}

static void MX_GPIO_Init(void)
{
  GPIO_InitTypeDef GPIO_InitStruct = {0};

  /* GPIO Ports Clock Enable */
  __HAL_RCC_GPIOB_CLK_ENABLE();
  __HAL_RCC_GPIOA_CLK_ENABLE();

  /*Configure GPIO pin Output Level */
  HAL_GPIO_WritePin(GPIOB, GPIO_PIN_14, GPIO_PIN_RESET);

  /*Configure GPIO pin : PB14 */
  GPIO_InitStruct.Pin = GPIO_PIN_14;
  GPIO_InitStruct.Mode = GPIO_MODE_OUTPUT_PP;
  GPIO_InitStruct.Pull = GPIO_NOPULL;
  GPIO_InitStruct.Speed = GPIO_SPEED_FREQ_LOW;
  HAL_GPIO_Init(GPIOB, &GPIO_InitStruct);

}

void Error_Handler(void)
{
  __disable_irq();
  while (1)
  {
  }
}
