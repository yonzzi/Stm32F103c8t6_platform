# file: uart_ram.ioc
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Mcu.Family=STM32F1
Mcu.Name=STM32F103C(8-B)Tx
Mcu.Package=LQFP48
NVIC.PriorityGroup=NVIC_PRIORITYGROUP_4
PA13.Mode=Serial_Wire
PA13.Signal=SYS_JTMS-SWDIO
PA14.Mode=Serial_Wire
PA14.Signal=SYS_JTCK-SWCLK
PB2.Signal=GPIO_Output
ProjectManager.HeapSize=0x200
ProjectManager.StackSize=0x400
ProjectManager.TargetToolchain=STM32CubeIDE
RCC.APB1Freq_Value=8000000
RCC.APB2Freq_Value=8000000
board=custom

// file: Core/Src/main.c
 /* USER CODE BEGIN Header */
/**
  ******************************************************************************
  * @file           : main.c
  * @brief          : Main program body
  ******************************************************************************
  * @attention
  *
  * Copyright (c) 2024 STMicroelectronics.
  * All rights reserved.
  *
  * This software is licensed under terms that can be found in the LICENSE file
  * in the root directory of this software component.
  * If no LICENSE file comes with this software, it is provided AS-IS.
  *
  ******************************************************************************
  */
/* USER CODE END Header */
#include "main.h"
#include "string.h"
#include "stdarg.h"

/* USER CODE BEGIN PV */
char new_fw_data[4708];
/* USER CODE END PV */

void SystemClock_Config(void);
static void MX_GPIO_Init(void);

/* USER CODE BEGIN 0 */
#include "string.h"
#include "stdarg.h"
#define GPIOA_BASE_ADD 0x40010800
#define GPIOB_BASE_ADD 0x40010C00

char recv_data[32];

void led_init()
{
   //before using any peripheral -> have to give clock for work
   __HAL_RCC_GPIOB_CLK_ENABLE(); //hal : tên hãng, RCC: bá»™ táº¡o clock
   //initial to set PB2 in output push-pull
   uint32_t* GPIOB_CRH = (uint32_t*)(GPIOB_BASE_ADD + 0x00);// add base + add offset
   *GPIOB_CRH |=(0b01<<8); //set PB2 in output config ( Mode[1,0] >00-> output; =00-> input) // <<22 lÃ  vá»‹ trÃ­ nha, do mÃ¬nh Ä‘á»ƒ cÃ³ 0bxx nÃªn nÃ³ Ä‘ang khÃ´ng lÃ  32 bit, pháº£i dá»‹ch nÃ³ Ä‘á»ƒ Ä‘Ãºng vá»‹ trÃ­
   *GPIOB_CRH &=~(0b11<<10); // set PB2  in push-pull mode (00)

}
void led_control(char led_state)
{
   //set led in PB2 light
   // add of output data register
   uint32_t* GPIOB_ODR = (uint32_t*)(GPIOB_BASE_ADD + 0x0C);
   if( led_state==1)
   *GPIOB_ODR |= 1<<2;
   else
    *GPIOB_ODR &= ~(1<<2);
}

void uart1_init()
{
   __HAL_RCC_GPIOA_CLK_ENABLE();
   //set PA9 as UART1_Tx, PA10 as UART2_Rx
   uint32_t* GPIOA_CRH = (uint32_t*)(0x40010804);// add base + add offset
    //clear reg using
   *GPIOA_CRH &=~(0xff<<4);
   *GPIOA_CRH |= (0b1001 <<4);  //  output TX PA9  Alternate function push-pull.
   *GPIOA_CRH |= (0b0100 <<8);  // input floating RX PA10.

    //set PA9,10 as choose pin
    uint32_t* AFIO_MAPR = (uint32_t*)(0x40010004);
    *AFIO_MAPR &=~(1<<2);//set map for using PA9,10
    //*AFIO_MAPR =(0<<2);      //set map for using PA9,10

//    UART :
//   + baudrate:9600
//   +frame:
//       + data len : 8 bit
//      +parity : none
   __HAL_RCC_USART1_CLK_ENABLE(); // RCC cấp clock cho uart : 16Mhz

   uint32_t* USART1_BRR = (uint32_t*)(0x40013808);
   uint32_t* USART1_CR1 = (uint32_t*)(0x4001380c);

   //*USART1_BRR =(104<<4)|(3<<0); //define div 104.1667
   *USART1_BRR =(52<<4)|(1<<0); //baud 9600 //fck=8M.
   *USART1_CR1 &=~(1<<10) ;//disable parity. if enable -> continue set even or odd in PS position in USART1_CR1 reg
   *USART1_CR1 &=~(1<<12) ; //use 8 bit data

   *USART1_CR1 |=(1<<13)|(1<<2)|(1<<3); //enable tx,rx và uart tổng

#if 0
   //enable RXNE interr -> when RXNE is set , UART1 generate interr event send to NVIC
   *USART1_CR1 |=(1<<5);

   //NVIC accept interrupt event , Which is send from uart
   uint32_t* NVIC_ISER1 = (uint32_t*)(0xE000E100 + 0x04);
   *NVIC_ISER1 |=(1<<(37-32)); //enable interrupt for event in position 37 in vector table( UART1)
#else
   //when RXNE is set, send signal to DMA1, DMA1 move data to RAM
//   uint32_t* USART1_CR3 = (uint32_t*)(0x40013814);
//   *USART1_CR3 |= (1<<6);

#endif

}
#define DMA1_BASE_ADD 0x40020000

void dma1_uart1_rx_init()
{
	__HAL_RCC_DMA1_CLK_ENABLE();
	//using DMA1 channel 5 for uart1rx
	//uint32_t* DMA1_CCR5 = (uint32_t*)(DMA1_BASE_ADD + 0x08 + 0x0d20 * 4); //( offset: 0x08 + 0d20 × (channel number – 1))
	uint32_t* DMA1_CCR5 = (uint32_t*)(0x40020058); //addr in app
	uint32_t* DMA1_CNDTR5 = (uint32_t*)(0x4002005c); //DMA channel x number of data register
	uint32_t* DMA1_CPAR5 = (uint32_t*)(0x40020060); // DMA channel x peripheral address register
	uint32_t* DMA1_CMAR5 = (uint32_t*)(0x40020064); // DMA channel x memory address register
	/*
	 * size : 7 bytes
	 * from peripheral addr: uart1_dr  0x40013804
	 * mem addr: rx_buffer ( recv_data) 0x2000042c - search addr in .map file in debug folder.
	 */
	*DMA1_CNDTR5 = 7;
	*DMA1_CPAR5 = 0x40013804;
	*DMA1_CMAR5 = recv_data;

	*DMA1_CCR5 |= 1<<7 ; // set memory increment mode -- if do not set this buffer will be override data
	//*DMA1_CCR5 |= 1<<5 ; // enable circular mode
	//*DMA1_CCR5 |= 1<<1 ; // Transfer complete interrupt enable
	 //enable dma after ( read reg(DMA1_CPAR5,DMA1_CMAR5,DMA1_CNDTR5,...) to detail about it)
	*DMA1_CCR5 |= 1<<0 ; //enable channel

	//NVIC accept interrupt event , Which is send from dma1 channel 5
	// uint32_t* NVIC_ISER0 = (uint32_t*)(0xE000E100 + 0x00);
	// *NVIC_ISER0 |=(1<<15); //enable interrupt for event in position 15 in vector table(dma1_channel 5)

}

void UART1_send_1byte(char data)
{
   uint32_t* USART1_SR = (uint32_t*)(0x40013800);
   uint32_t* USART1_DR = (uint32_t*)(0x40013804);
   while ( ((*USART1_SR>>7) & 1) == 0 ); // waiting DR empty
   *USART1_DR=data;
   while ( ((*USART1_SR>>6) & 1) == 0 ); //waiting transmit completion
   *USART1_SR &=~(1<<6); //clear bit TC when transmit done.
}
void UART1_send_string(char *msg)
{
   int msg_lenth =strlen(msg);
   for (int i=0;i < msg_lenth;i++)
   {
      UART1_send_1byte(msg[i]);
      HAL_Delay(1);
   }
}

void uart_printf(char* format, ...)
{
   va_list aptr;
   va_start(aptr, format);
   char buffer[128]={0};
	vsprintf(buffer,format,aptr);
	UART1_send_string(buffer);
	va_end(aptr);
}
char UART1_receive_1byte()
{
   uint32_t* USART1_SR = (uint32_t*)(0x40013800);
   uint32_t* USART1_DR = (uint32_t*)(0x40013804);
   while ( ((*USART1_SR>>5) & 1) == 0 ); // waiting RXNE flag to DR have data
   char recv_data= *USART1_DR; //read data
   return recv_data;

}
int rx_index=0;

void custom_USART1_IRQHandler()
{
   uint32_t* USART1_DR = (uint32_t*)(0x40013804);
   recv_data[rx_index++]=*USART1_DR;
   //note: if RXTN reg have not clear by read DR ( or sth) reg ->  clear it ( read rm)
    if (strstr(recv_data,"led on")!=NULL)
    {
        led_control(1);
        rx_index=0;
        memset(recv_data, 0,sizeof(recv_data));//clear data =0

    }
    else if (strstr(recv_data,"led off")!=NULL)
    {
       led_control(0);
       rx_index=0;
       memset(recv_data, 0,sizeof(recv_data));//clear data =0

    }
}

void custom_DMA1_channel5_IRQHandler()
{
	__asm("nop");
	//clear flag interrupt (when transfer interrupt complete);
	uint32_t* DMA1_IFCR = (uint32_t*)(0x40020004);
	*DMA1_IFCR |= 1<<17;
	if (strstr(recv_data,"led onn")!=NULL)
	    {
	        led_control(1);

	    }
	    else if (strstr(recv_data,"led off")!=NULL)
	    {
	       led_control(0);

	    }
	 memset(recv_data, 0, 7);

}

#define FLASH_BASE_ADD 0x40022000
uint32_t *FLASH_SR = (uint32_t *) (FLASH_BASE_ADD + 0x0C);  //Flash status register
uint32_t *FLASH_CR = (uint32_t *) (FLASH_BASE_ADD + 0x10);  //Flash status register
uint32_t *FLASH_AR = (uint32_t *) (FLASH_BASE_ADD + 0x14);  //Flash address register
uint32_t *FLASH_KEYR = (uint32_t *) (FLASH_BASE_ADD + 0x04);  //Flash address register

__attribute__((section(".Func_in_Ram"))) void Flash_erase_page(uint32_t start_add){

	if(((*FLASH_CR >> 7) & 1) == 1){
		// unlocking sequence should be written to the FLASH_KEYR
		*FLASH_KEYR = 0x45670123;
		*FLASH_KEYR = 0xCDEF89AB;
	}

	// Check that no Flash memory operation is ongoing by checking the BSY bit in the FLASH_SR register
	while( ((*FLASH_SR >> 0) & 1) == 1  );

	//Set the PER bit in the FLASH_CR register: Page Erase chosen
	*FLASH_CR |= 1<<1;

	//Program the FLASH_AR register to select a page to erase
	*FLASH_AR = (uint32_t *)(start_add);

	//Set the STRT bit in the FLASH_CR register
	*FLASH_CR |=(1<<6);

	//Wait for the BSY bit to be reset
	while( ((*FLASH_SR >> 0) & 1) == 1 );

	//clear the PER bit in the FLASH_CR register: Page Erase chosen
	*FLASH_CR &= ~(1<<1);
}

__attribute__((section(".Func_in_Ram"))) void Flash_programing(uint32_t address, uint8_t *data, uint32_t num_byte_data){
	int x = num_byte_data/1024 + 1;
	uint32_t add_erase;
	for(int i=0; i< x; i++){
		add_erase = (address + i*1024);
		Flash_erase_page(add_erase);
	}

	if(((*FLASH_CR >> 7) & 1) == 1){
		// unlocking sequence should be written to the FLASH_KEYR
		*FLASH_KEYR = 0x45670123;
		*FLASH_KEYR = 0xCDEF89AB;
	}

	// Check that no Flash memory operation is ongoing by checking the BSY bit in the FLASH_SR register
	while( ((*FLASH_SR >> 0) & 1) == 1  );

	//Set the PG bit in the FLASH_CR register: Flash programming chosen.
	*FLASH_CR |= 1<<0;

	//Perform the data write (half-word = 16 bit) at the desired address.
	for(int i =0; i< num_byte_data; i+=2){
		*(uint16_t*)(address) = (uint16_t)(data[i] + (data[i+1] << 8));
		address += 2; // 16bits = 2 byte. dia chi tang dan 2byte
	}

	//Wait for the BSY bit to be reset
	while( ((*FLASH_SR >> 0) & 1) == 1 );

	//clear the PG bit in the FLASH_CR register
	*FLASH_CR &= ~(1<<0);

}
__attribute__((section(".Func_in_Ram"))) void update_firmware()
{
	//disable system tick because this func always run ( always create interrupt every 1s to be able to use hal_delay -> if erease flash this will erease too)
	uint32_t *STCSR = (uint32_t*)(0xE000E010); //system control in core arm doc
	*STCSR &=~1;

	//erease flash page 0

	// program page 0 ( addr: 0x08000000) with data in new_fw_data ( in RAM)
	Flash_programing(0x08000000, new_fw_data, sizeof(new_fw_data));

	//reset system
	   uint32_t *AIRCR = (uint32_t*)(0xE000ED0C);
	   *AIRCR = (0x05fa << 16) | (1<<2); //set VECTKEYSTAT and SYSRESETREQ in core arm

}

/* USER CODE END 0 */

int main(void)
{

  /* MCU Configuration--------------------------------------------------------*/

  /* Reset of all peripherals, Initializes the Flash interface and the Systick. */
  HAL_Init();

  /* Configure the system clock */
  SystemClock_Config();

  /* Initialize all configured peripherals */
  MX_GPIO_Init();
  /* USER CODE BEGIN 2 */
   uart1_init();
   dma1_uart1_rx_init();
  /* USER CODE END 2 */

  /* Infinite loop */
  /* USER CODE BEGIN WHILE */
uart_printf("pls send %d byte to stm32\r\n", sizeof(new_fw_data));
for (int i=0;i<sizeof(new_fw_data);i++)
{
	new_fw_data[i]=UART1_receive_1byte();
}
uart_printf("start update device. Don't power off device\r\n");
update_firmware();
  while (1)
  {
    /* USER CODE END WHILE */

  }
}

void SystemClock_Config(void)
{
  RCC_OscInitTypeDef RCC_OscInitStruct = {0};
  RCC_ClkInitTypeDef RCC_ClkInitStruct = {0};

  /** Initializes the RCC Oscillators according to the specified parameters
  * in the RCC_OscInitTypeDef structure.
  */
  RCC_OscInitStruct.OscillatorType = RCC_OSCILLATORTYPE_HSI;
  RCC_OscInitStruct.HSIState = RCC_HSI_ON;
  RCC_OscInitStruct.HSICalibrationValue = RCC_HSICALIBRATION_DEFAULT;
  RCC_OscInitStruct.PLL.PLLState = RCC_PLL_NONE;
  if (HAL_RCC_OscConfig(&RCC_OscInitStruct) != HAL_OK)
  {
    Error_Handler();
  }

  /** Initializes the CPU, AHB and APB buses clocks
  */
  RCC_ClkInitStruct.ClockType = RCC_CLOCKTYPE_HCLK|RCC_CLOCKTYPE_SYSCLK
                              |RCC_CLOCKTYPE_PCLK1|RCC_CLOCKTYPE_PCLK2;
  RCC_ClkInitStruct.SYSCLKSource = RCC_SYSCLKSOURCE_HSI;
  RCC_ClkInitStruct.AHBCLKDivider = RCC_SYSCLK_DIV1;
  RCC_ClkInitStruct.APB1CLKDivider = RCC_HCLK_DIV1;
  RCC_ClkInitStruct.APB2CLKDivider = RCC_HCLK_DIV1;

  if (HAL_RCC_ClockConfig(&RCC_ClkInitStruct, FLASH_LATENCY_0) != HAL_OK)
  {
    Error_Handler();
  }
}

static void MX_GPIO_Init(void)
{
  GPIO_InitTypeDef GPIO_InitStruct = {0};

  /* GPIO Ports Clock Enable */
  __HAL_RCC_GPIOB_CLK_ENABLE();
  __HAL_RCC_GPIOA_CLK_ENABLE();

  /*Configure GPIO pin Output Level */
  HAL_GPIO_WritePin(GPIOB, GPIO_PIN_2, GPIO_PIN_RESET);

  /*Configure GPIO pin : PB2 */
  GPIO_InitStruct.Pin = GPIO_PIN_2;
  GPIO_InitStruct.Mode = GPIO_MODE_OUTPUT_PP;
  GPIO_InitStruct.Pull = GPIO_NOPULL;
  GPIO_InitStruct.Speed = GPIO_SPEED_FREQ_LOW;
  HAL_GPIO_Init(GPIOB, &GPIO_InitStruct);

}

void Error_Handler(void)
{
  __disable_irq();
  while (1)
  {
  }
}
